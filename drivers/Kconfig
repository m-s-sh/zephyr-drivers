## drivers/Kconfig
```kconfig
# SPDX-License-Identifier: Apache-2.0
# Copyright (c) 2025 Blue Vending

rsource "led/Kconfig"
rsource "modem/Kconfig"
rsource "serial/Kconfig"
```

## drivers/led/Kconfig
```kconfig
# Copyright (c) 2025 Blue Vending
# SPDX-License-Identifier: Apache-2.0

# Status LED driver configuration

config STATUS_LED
    bool "Status LED Driver"
    depends on GPIO
    help
      Enable support for status LEDs.

if STATUS_LED

endif # STATUS_LED
```

## drivers/modem/Kconfig
```kconfig
# SPDX-License-Identifier: Apache-2.0
# Copyright (c) 2025 Blue Vending

rsource "simcom/Kconfig"
```

## drivers/modem/simcom/Kconfig
```kconfig
# SPDX-License-Identifier: Apache-2.0
# Copyright (c) 2025 Blue Vending

# SIM800L modem configuration
config MODEM_SIM800L
	bool "SIM800L Modem Driver"
	select MODEM_CONTEXT
	select MODEM_CMD_HANDLER
	select MODEM_IFACE_UART
	select MODEM_SOCKET
	select NET_OFFLOAD
	select NET_SOCKETS_OFFLOAD
	imply GPIO
	help
	  Enable support for SIM800L GSM/GPRS modem using modern modem framework.

	  The SIM800L is a GSM/GPRS module that supports:
	  - Quad-band GSM/GPRS connectivity
	  - AT command interface via UART
	  - CMUX multiplexing support
	  - PPP data connections
	  - Reset control via GPIO

if MODEM_SIM800L

config MODEM_SIM800L_LOG_LEVEL
	int "SIM800L modem log level"
	default 1
	help
	  Set the log level for SIM800L modem driver.
	  0 - None
	  1 - Error messages
	  2 - Warning messages
	  3 - Informational messages
	  4 - Debug messages

config MODEM_SIM800L_APN
	string "SIM800L APN"
	default "internet"
	help
	  Access Point Name (APN) for SIM800L modem data connection.
	  Leave empty if not required by your network provider.

endif # MODEM_SIM800L
```

## drivers/serial/Kconfig
```kconfig
# SPDX-License-Identifier: Apache-2.0
# Copyright (c) 2025 Blue Vending

config UART_RPI_PICO_PIO_ENHANCED
	bool "Raspberry Pi Pico PIO UART Enhanced Driver"
	default n
	select UART
	select UART_WIDE_DATA
	help
	  Enables the Raspberry Pi Pico PIO UART Driver. Supports 9 bit mode,

config UART_RPI_PICO_PIO_ENHANCED_LOG_LEVEL
	int "Raspberry Pi Pico PIO UART Enhanced Driver Log Level"
	depends on UART_RPI_PICO_PIO_ENHANCED
	default 3
	help
	  Sets the log level for the Raspberry Pi Pico PIO UART Enhanced Driver.
```

## dts/bindings/led/status-led.yaml
```yaml
# SPDX-License-Identifier: Apache-2.0
# Copyright (c) 2025 Blue Vending

description: Status LED driver

compatible: "status-led"

properties:
  led-gpios:
    type: phandle-array
    required: true
    description: GPIO phandle and specifier for the LED pin

  label:
    type: string
    description: Human readable string describing the device
```

## dts/bindings/modem/simcom,sim800l.yaml
```yaml
# SPDX-License-Identifier: Apache-2.0
# Copyright (c) 2025 Blue Vending

description: Simcom Sim800L modem

compatible: "simcom,sim800l"

include: zephyr,cellular-modem-device.yaml
```

## dts/bindings/serial/raspberrypi,pico-uart-pio-enhanced.yaml
```yaml
description: Raspberry Pi Pico PIO UART enhanced

compatible: raspberrypi,pico-uart-pio-enhanced

include: [uart-controller.yaml, "raspberrypi,pico-pio-device.yaml"]
```
